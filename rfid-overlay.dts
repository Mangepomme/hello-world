/dts-v1/;
/plugin/;

/ {
        compatible = "brcm, brcm2835";

        fragment@0 {
                target = <&spi1>;
                __overlay__ {
                        #address-cells = <1>;
                        #size-cells = <0>;
                        status = "okay";
                        pinctrl-names = "default";

                        rfid@0 {
                                spi-max-frequency = <10000000>;
                                reg = <0>;
                                compatible = "nxp.mfrc522";
                        };
                };
        };

        fragment@1 {
                target = <&spidev1>;
                __overlay__ {
                        status = "disabled";
                };
        };
};
